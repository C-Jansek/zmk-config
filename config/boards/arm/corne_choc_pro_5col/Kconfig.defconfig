## config/boards/arm/corne_choc_pro_5col/Kconfig.defconfig
```kconfig
# Copyright (c) 2020 The ZMK Contributors
# SPDX-License-Identifier: MIT

if BOARD_CORNE_CHOC_PRO_5COL_LEFT

config ZMK_SPLIT_ROLE_CENTRAL
	default y

endif # BOARD_CORNE_CHOC_PRO_5COL_LEFT

if BOARD_CORNE_CHOC_PRO_5COL_LEFT || BOARD_CORNE_CHOC_PRO_5COL_RIGHT

config BOARD
	default "corne_choc_pro_5col"

config ZMK_SPLIT
	default y

if USB

config USB_NRFX
	default y

config USB_DEVICE_STACK
	default y

endif # USB

config BT_CTLR
	default BT

config I2C
	default y

config ZMK_MAX17048
	default y

endif # BOARD_CORNE_CHOC_PRO_5COL_LEFT || BOARD_CORNE_CHOC_PRO_5COL_RIGHT
```

## config/boards/arm/piantor_pro_bt_5col/Kconfig.board
```kconfig
# Copyright (c) 2020 The ZMK Contributors
# SPDX-License-Identifier: MIT

config BOARD_PIANTOR_PRO_BT_5COL_LEFT
	bool "Piantor Pro BT 5-Col Left"
	depends on SOC_NRF52840_QIAA

config BOARD_PIANTOR_PRO_BT_5COL_RIGHT
	bool "Piantor Pro BT 5-Col Right"
	depends on SOC_NRF52840_QIAA
```
